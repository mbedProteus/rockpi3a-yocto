## sources/meta-rockpi3/conf/distro/include/rockchip-base.inc
```bitbake
require conf/distro/poky.conf

DISTRO = "rockchip"
DISTRO_NAME = "Rockchip Release Distro"
DISTRO_VERSION = "dunfell"

MAINTAINER = "Thai Kien Le (thaikien.kc@gmail.com)"

INHERIT_remove = "uninative"
```

## sources/meta-rockpi3/conf/distro/rockchip-x11.conf
```bitbake
include conf/distro/include/rockchip-base.inc

DISTRO = "rockchip-x11"
DISTRO_FEATURES_append = " x11 systemd pam"
```

## sources/meta-rockpi3/conf/layer.conf
```bitbake
# We have a conf and classes directory, append to BBPATH
BBPATH .= ":${LAYERDIR}"

# We have a recipes directory, add to BBFILES
BBFILES += "${LAYERDIR}/recipes*/*/*.bb ${LAYERDIR}/recipes*/*/*.bbappend"

BBFILE_COLLECTIONS += "rockpi3"
BBFILE_PATTERN_rockpi3 := "^${LAYERDIR}/"
BBFILE_PRIORITY_rockpi3 = "1"

LAYERSERIES_COMPAT_rockpi3 = "zeus dunfell"
```

## sources/meta-rockpi3/conf/machine/include/rockpi-3.inc
```bitbake
SOC_FAMILY = "rk3568"

require conf/machine/include/arm/arch-armv8a.inc
require conf/machine/include/soc-family.inc

MACHINEOVERRIDES =. "mali-gpu:mali-midgard:"

PREFERRED_PROVIDER_virtual/kernel = "linux-rockpi-3a"
PREFERRED_VERSION_linux-rockchip = "4.19"

SERIAL_CONSOLES = "1500000;ttyFIQ0"
KERNEL_IMAGETYPE = "Image"
KBUILD_DEFCONFIG = "rockchip_linux_defconfig"

PREFERRED_PROVIDER_virtual/bootloader ?= "u-boot-rockpi-3a"

MACHINE_ESSENTIAL_EXTRA_RRECOMMENDS += "\
   kernel-modules \
   resize-helper \
"

IMAGE_FSTYPES += "rockpi3-gpt-img"
IMAGE_CLASSES += "rockpi3-gpt-img"
```

## sources/meta-rockpi3/conf/machine/rockpi-3a.conf
```bitbake
#@TYPE: Machine
#@NAME: RockPi-3a machine
#@DESCRIPTION: RockPi-3a development board config file

require conf/machine/include/rockpi-3.inc

KERNEL_DEVICETREE = "rockchip/rk3568-rock-3a.dtb"
UBOOT_MACHINE = "rock-3a-rk3568_config"

MACHINE_ESSENTIAL_EXTRA_RRECOMMENDS += "\
   rkwifibt-firmware \
"
```
